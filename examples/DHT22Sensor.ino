/* This Source Code Form is subject to the terms of the Mozilla Public
 * License, v. 2.0. If a copy of the MPL was not distributed with this
 * file, You can obtain one at http://mozilla.org/MPL/2.0/. */

#include "Arduino.h"
#include <ESP8266WiFi.h>
#include <ESP8266WiFiMulti.h>
#include <ESP8266HTTPClient.h>
#include <MysecSwitch.h>
#include "DHT.h"

#define DHTPIN D4     // what digital pin we're connected to
// Uncomment whatever type you're using!
//#define DHTTYPE DHT11   // DHT 11
#define DHTTYPE DHT22   // DHT 22  (AM2302), AM2321
//#define DHTTYPE DHT21   // DHT 21 (AM2301)
// Initialize DHT sensor.
// Note that older versions of this library took an optional third parameter to
// tweak the timings for faster processors.  This parameter is no longer needed
// as the current DHT reading algorithm adjusts itself to work on faster procs.
DHT dht(DHTPIN, DHTTYPE);



// Replace these keys with the ones you receive after registration at https://thinkingthing.space/mysec
const char passkey2[] = "ReplaceReplaceReplaceReplaceReplaceReplace1=";
// Replace id with the device id from https://thinkingthing.space/mysec
const uint64_t id = 6;
// This is the UDP port used to pair with the Android MysecSwitch App for local communication. The same port has to be configured at the Android Mysecswitch App.
const int port = 8876;
// Local Wifi Router config
const char wifiSSID[] = "ssid";
const char wifiPasswd[] = "password";

ESP8266WiFiMulti wifiMulti;
// URL of the Mysec Website (you don't need to change this)
const char url[] = "http://thinkingthing.space/mysec";
// MysecSwitch instance
MysecSwitch dev;


void setup()
{
  Serial.begin(115200);
  WiFi.mode(WIFI_STA);
  wifiMulti.addAP(wifiSSID, wifiPasswd);

  Serial.println("\nConnecting Wifi...");
  while (wifiMulti.run() != WL_CONNECTED && millis() < 60000) { // 60 segundos para conectar
    delay(500);
    Serial.print(".");
  }
  if (wifiMulti.run() == WL_CONNECTED) {
    Serial.println("");
    Serial.println("WiFi connected");
    Serial.println("IP address: ");
    Serial.println(WiFi.localIP());

    // Setup MysecSwitch library
    // url      -> URL for the Mysec Website, it has to be "http://thinkingthing.space/mysec"
    // id       -> ID for the device given by Mysec Website
    // port     -> UDP port for local LAN connection with a viewer
    // true     -> set to true if you want this device to respond to Mysec Alarm events
    // passkey2 -> Initial device passkey generated by Mysec Website, this passkey will be replaced at device synchronization.
    dev.init(url, id, port, true, passkey2);

    // In this example we have 3 INPUT analog virtual pins and they are pure virtual (not connected to any GPIO)

    // Remember to setup device at https://thinkingthing.space/mysec

    // Pin number 1 will be used for humidity
    // Setup pin number 1. Parameter details:
    // 1                    -> identify this pin as pin number 1 (the same number has to be configured at Mysec Website)
    // false/* output */    -> this is an INPUT pin
    // false/* digital */   -> this pin accepts analog values.
    // false/* automatic */ -> this pin is not automatically read by MysecSwitch.
    // 0                    -> This pin is not automatic then this parameter is irrelevant.
    dev.setupPin(1, false /*input*/, false /*analog*/, false/*not automatic*/, 0/*physical pin*/);
    // Pin number 2 will be used for temperature in Celsius
    // Setup pin number 2. Parameter details:
    // 2                    -> identify this pin as pin number 2 (the same number has to be configured at Mysec Website)
    // false/* output */    -> this is an INPUT pin
    // false/* digital */   -> this pin accepts analog values.
    // false/* automatic */ -> this pin is not automatically read by MysecSwitch.
    // 0                    -> This pin is not automatic then this parameter is irrelevant.
    dev.setupPin(2, false /*input*/, false /*analog*/, false/*not automatic*/, 0/*physical pin*/);
    // Pin number 3 will be used for temperature in Fahrenheit
    // Setup pin number 3. Parameter details:
    // 3                    -> identify this pin as pin number 3 (the same number has to be configured at Mysec Website)
    // false/* output */    -> this is an INPUT pin
    // false/* digital */   -> this pin accepts analog values.
    // false/* automatic */ -> this pin is not automatically read by MysecSwitch.
    // 0                    -> This pin is not automatic then this parameter is irrelevant.
    dev.setupPin(3, false /*input*/, false /*analog*/, false/*not automatic*/, 0/*physical pin*/);

    // D4 is the "NodeMCU/Wemos D1 mini" label on the printed circuit and is equivalent to GPIO-2 (D4 constant value is 2).
    // D4 is used by Wemos D1 mini DTH Pro Shield.
    pinMode(D4, INPUT); // can be replaced by pinMode(2, INPUT);
    // Initialize DHT sensor.
    dht.begin();
  } else {
    // can't connect to wifi router
    // retry
    Serial.println("reset after 15 seconds");
    delay(15000);
    ESP.restart();
  }
}
void loop() {
  // Reading temperature or humidity takes about 250 milliseconds!
  // Sensor readings may also be up to 2 seconds 'old' (its a very slow sensor)
  float h = dht.readHumidity();
  // Read temperature as Celsius (the default)
  float t = dht.readTemperature();
  // Read temperature as Fahrenheit (isFahrenheit = true)
  float f = dht.readTemperature(true);
  // Check if any reads failed and exit early (to try again).
  if (isnan(h) || isnan(t) || isnan(f)) {
    Serial.println("Failed to read from DHT sensor!");
  } else {
    Serial.print("Humidity: ");
    Serial.print(h);
    Serial.print(" %\t");
    Serial.print("Temperature: ");
    Serial.print(t);
    Serial.print(" *C ");
    Serial.print(f);
    Serial.println(" *F");
    // prepare values to send
    dev.setValue(1, h);
    dev.setValue(2, t);
    dev.setValue(3, f);
  }
  // publish values
  dev.loop();
  // Wait some time between measurements.
  delay(10000);
}
